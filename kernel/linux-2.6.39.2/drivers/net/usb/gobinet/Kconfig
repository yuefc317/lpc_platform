## kernel/linux-2.6.39.2/drivers/net/usb/gobinet/Kconfig
```kconfig
config USB_GOBINET
	tristate "SIMCOM Modem USB Ethernet driver"
	default m
	help
	  Module used to access internet by SIMCOM modem
```
